## modules/zmk-rgb-layer/Kconfig
```kconfig
menuconfig ZMK_RGB_LAYER
    bool "ZMK RGB Layer Control"
    help
        Enable RGB layer control for per-layer and per-key LED colors
```

## modules/zmk-rgb-layer/dts/bindings/behaviors/zmk,behavior-rgb-layer-set.yaml
```yaml
description: |
  Sets the active RGB layer color/index for zmk-rgb-layer. Not meant to be
  bound to a physical key; the rgb_layer driver invokes this internally
  (as a BEHAVIOR_LOCALITY_GLOBAL behavior) so that layer changes, which are
  only known on the split central half, also reach the peripheral half's
  LEDs via ZMK's existing split behavior-invoke transport.

compatible: "zmk,behavior-rgb-layer-set"

include: one_param.yaml
```

## modules/zmk-rgb-layer/dts/bindings/zmk,rgb-layer.yaml
```yaml
description: ZMK RGB Layer Control

compatible: "zmk,rgb-layer"

properties:
  layer-colors:
    type: array
    description: |
      Array of RGB colors (0xRRGGBB format) for each layer.
      Example: <0xFF0000 0x00FF00 0x0000FF> for Red, Green, Blue

  key-colors:
    type: array
    description: |
      Array of RGB colors for individual keys per layer.
      Organized as [key0_layer0, key0_layer1, ..., key1_layer0, ...]
```
