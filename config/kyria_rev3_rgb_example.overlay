/*
 * Example RGB Layer Configuration for Kyria Rev3
 * Copy the rgb_layer section to your kyria_rev3.overlay to use it
 */

/ {
    rgb_layer: rgb_layer {
        compatible = "zmk,rgb-layer";

        /* Layer base colors */
        layer-colors = <
            0xFF0000  /* Layer 0 (Alphas): Red */
            0x00FF00  /* Layer 1 (Numbers): Green */
            0x0000FF  /* Layer 2 (Nav): Blue */
            0xFFFF00  /* Layer 3 (Config): Yellow */
        >;

        /* Individual key colors per layer (optional) */
        /* This is for future use - currently all keys use layer base color */
        /* Format: for each key (0-49), one color per layer */
        key-colors = <
            /* Key 0 - ESC */ 0xFF0000 0xFF0000 0xFF0000 0xFF0000
            /* Key 1 - Q   */ 0xFF0000 0xFF0000 0xFF0000 0xFF0000
            /* Add more keys as needed... */
            /* Padding for remaining 48 keys (192 more entries) */
            0x000000 0x000000 0x000000 0x000000
            0x000000 0x000000 0x000000 0x000000
            0x000000 0x000000 0x000000 0x000000
            0x000000 0x000000 0x000000 0x000000
            0x000000 0x000000 0x000000 0x000000
            0x000000 0x000000 0x000000 0x000000
            0x000000 0x000000 0x000000 0x000000
            0x000000 0x000000 0x000000 0x000000
            0x000000 0x000000 0x000000 0x000000
            0x000000 0x000000 0x000000 0x000000
            0x000000 0x000000 0x000000 0x000000
            0x000000 0x000000 0x000000 0x000000
            0x000000 0x000000 0x000000 0x000000
            0x000000 0x000000 0x000000 0x000000
            0x000000 0x000000 0x000000 0x000000
            0x000000 0x000000 0x000000 0x000000
            0x000000 0x000000 0x000000 0x000000
            0x000000 0x000000 0x000000 0x000000
            0x000000 0x000000 0x000000 0x000000
            0x000000 0x000000 0x000000 0x000000
            0x000000 0x000000 0x000000 0x000000
            0x000000 0x000000 0x000000 0x000000
            0x000000 0x000000 0x000000 0x000000
            0x000000 0x000000 0x000000 0x000000
            0x000000 0x000000 0x000000 0x000000
            0x000000 0x000000 0x000000 0x000000
            0x000000 0x000000 0x000000 0x000000
            0x000000 0x000000 0x000000 0x000000
            0x000000 0x000000 0x000000 0x000000
            0x000000 0x000000 0x000000 0x000000
            0x000000 0x000000 0x000000 0x000000
            0x000000 0x000000 0x000000 0x000000
            0x000000 0x000000 0x000000 0x000000
            0x000000 0x000000 0x000000 0x000000
            0x000000 0x000000 0x000000 0x000000
            0x000000 0x000000 0x000000 0x000000
            0x000000 0x000000 0x000000 0x000000
            0x000000 0x000000 0x000000 0x000000
            0x000000 0x000000 0x000000 0x000000
            0x000000 0x000000 0x000000 0x000000
            0x000000 0x000000 0x000000 0x000000
            0x000000 0x000000 0x000000 0x000000
            0x000000 0x000000 0x000000 0x000000
            0x000000 0x000000 0x000000 0x000000
            0x000000 0x000000 0x000000 0x000000
            0x000000 0x000000 0x000000 0x000000
            0x000000 0x000000 0x000000 0x000000
            0x000000 0x000000 0x000000 0x000000
            0x000000 0x000000 0x000000 0x000000
            0x000000 0x000000 0x000000 0x000000
        >;
    };
};
