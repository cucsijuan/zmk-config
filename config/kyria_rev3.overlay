#include <dt-bindings/zmk/keys.h>

/ {
    rgb_layer: rgb_layer {
        compatible = "zmk,rgb-layer";

        /* Layer base colors (0xRRGGBB format) */
        layer-colors = <
            0xFF0000  /* Layer 0 (Alphas): Red */
            0x00FF00  /* Layer 1 (Numbers): Green */
            0x0000FF  /* Layer 2 (Nav): Blue */
            0xFFFF00  /* Layer 3 (Config): Yellow */
            0x000000  /* Layer 4: Off */
            0x000000  /* Layer 5: Off */
            0x000000  /* Layer 6: Off */
            0x000000  /* Layer 7: Off */
            0x000000  /* Layer 8: Off */
            0x000000  /* Layer 9: Off */
            0x000000  /* Layer 10: Off */
            0x000000  /* Layer 11: Off */
            0x000000  /* Layer 12: Off */
            0x000000  /* Layer 13: Off */
            0x000000  /* Layer 14: Off */
            0x000000  /* Layer 15: Off */
        >;

        /* Per-key colors (50 keys × 16 layers = 800 entries) */
        /* Currently all zeros - update with your specific key colors per layer */
        key-colors = <
            0x000000 0x000000 0x000000 0x000000 0x000000 0x000000 0x000000 0x000000
            0x000000 0x000000 0x000000 0x000000 0x000000 0x000000 0x000000 0x000000
            0x000000 0x000000 0x000000 0x000000 0x000000 0x000000 0x000000 0x000000
            0x000000 0x000000 0x000000 0x000000 0x000000 0x000000 0x000000 0x000000
            0x000000 0x000000 0x000000 0x000000 0x000000 0x000000 0x000000 0x000000
            0x000000 0x000000 0x000000 0x000000 0x000000 0x000000 0x000000 0x000000
            0x000000 0x000000 0x000000 0x000000 0x000000 0x000000 0x000000 0x000000
            0x000000 0x000000 0x000000 0x000000 0x000000 0x000000 0x000000 0x000000
            0x000000 0x000000 0x000000 0x000000 0x000000 0x000000 0x000000 0x000000
            0x000000 0x000000 0x000000 0x000000 0x000000 0x000000 0x000000 0x000000
            0x000000 0x000000 0x000000 0x000000 0x000000 0x000000 0x000000 0x000000
            0x000000 0x000000 0x000000 0x000000 0x000000 0x000000 0x000000 0x000000
            0x000000 0x000000 0x000000 0x000000 0x000000 0x000000 0x000000 0x000000
            0x000000 0x000000 0x000000 0x000000 0x000000 0x000000 0x000000 0x000000
            0x000000 0x000000 0x000000 0x000000 0x000000 0x000000 0x000000 0x000000
            0x000000 0x000000 0x000000 0x000000 0x000000 0x000000 0x000000 0x000000
            0x000000 0x000000 0x000000 0x000000 0x000000 0x000000 0x000000 0x000000
            0x000000 0x000000 0x000000 0x000000 0x000000 0x000000 0x000000 0x000000
            0x000000 0x000000 0x000000 0x000000 0x000000 0x000000 0x000000 0x000000
            0x000000 0x000000 0x000000 0x000000 0x000000 0x000000 0x000000 0x000000
            0x000000 0x000000 0x000000 0x000000 0x000000 0x000000 0x000000 0x000000
            0x000000 0x000000 0x000000 0x000000 0x000000 0x000000 0x000000 0x000000
            0x000000 0x000000 0x000000 0x000000 0x000000 0x000000 0x000000 0x000000
            0x000000 0x000000 0x000000 0x000000 0x000000 0x000000 0x000000 0x000000
            0x000000 0x000000 0x000000 0x000000 0x000000 0x000000 0x000000 0x000000
            0x000000 0x000000 0x000000 0x000000 0x000000 0x000000 0x000000 0x000000
            0x000000 0x000000 0x000000 0x000000 0x000000 0x000000 0x000000 0x000000
            0x000000 0x000000 0x000000 0x000000 0x000000 0x000000 0x000000 0x000000
            0x000000 0x000000 0x000000 0x000000 0x000000 0x000000 0x000000 0x000000
            0x000000 0x000000 0x000000 0x000000 0x000000 0x000000 0x000000 0x000000
            0x000000 0x000000 0x000000 0x000000 0x000000 0x000000 0x000000 0x000000
            0x000000 0x000000 0x000000 0x000000 0x000000 0x000000 0x000000 0x000000
            0x000000 0x000000 0x000000 0x000000 0x000000 0x000000 0x000000 0x000000
            0x000000 0x000000 0x000000 0x000000 0x000000 0x000000 0x000000 0x000000
            0x000000 0x000000 0x000000 0x000000 0x000000 0x000000 0x000000 0x000000
            0x000000 0x000000 0x000000 0x000000 0x000000 0x000000 0x000000 0x000000
            0x000000 0x000000 0x000000 0x000000 0x000000 0x000000 0x000000 0x000000
            0x000000 0x000000 0x000000 0x000000 0x000000 0x000000 0x000000 0x000000
            0x000000 0x000000 0x000000 0x000000 0x000000 0x000000 0x000000 0x000000
            0x000000 0x000000 0x000000 0x000000 0x000000 0x000000 0x000000 0x000000
            0x000000 0x000000 0x000000 0x000000 0x000000 0x000000 0x000000 0x000000
            0x000000 0x000000 0x000000 0x000000 0x000000 0x000000 0x000000 0x000000
            0x000000 0x000000 0x000000 0x000000 0x000000 0x000000 0x000000 0x000000
            0x000000 0x000000 0x000000 0x000000 0x000000 0x000000 0x000000 0x000000
            0x000000 0x000000 0x000000 0x000000 0x000000 0x000000 0x000000 0x000000
            0x000000 0x000000 0x000000 0x000000 0x000000 0x000000 0x000000 0x000000
            0x000000 0x000000 0x000000 0x000000 0x000000 0x000000 0x000000 0x000000
            0x000000 0x000000 0x000000 0x000000 0x000000 0x000000 0x000000 0x000000
            0x000000 0x000000 0x000000 0x000000 0x000000 0x000000 0x000000 0x000000
            0x000000 0x000000 0x000000 0x000000 0x000000 0x000000 0x000000 0x000000
            0x000000 0x000000 0x000000 0x000000 0x000000 0x000000 0x000000 0x000000
            0x000000 0x000000 0x000000 0x000000 0x000000 0x000000 0x000000 0x000000
            0x000000 0x000000 0x000000 0x000000 0x000000 0x000000 0x000000 0x000000
            0x000000 0x000000 0x000000 0x000000 0x000000 0x000000 0x000000 0x000000
            0x000000 0x000000 0x000000 0x000000 0x000000 0x000000 0x000000 0x000000
            0x000000 0x000000 0x000000 0x000000 0x000000 0x000000 0x000000 0x000000
            0x000000 0x000000 0x000000 0x000000 0x000000 0x000000 0x000000 0x000000
            0x000000 0x000000 0x000000 0x000000 0x000000 0x000000 0x000000 0x000000
            0x000000 0x000000 0x000000 0x000000 0x000000 0x000000 0x000000 0x000000
            0x000000 0x000000 0x000000 0x000000 0x000000 0x000000 0x000000 0x000000
            0x000000 0x000000 0x000000 0x000000 0x000000 0x000000 0x000000 0x000000
            0x000000 0x000000 0x000000 0x000000 0x000000 0x000000 0x000000 0x000000
            0x000000 0x000000 0x000000 0x000000 0x000000 0x000000 0x000000 0x000000
            0x000000 0x000000 0x000000 0x000000 0x000000 0x000000 0x000000 0x000000
            0x000000 0x000000 0x000000 0x000000 0x000000 0x000000 0x000000 0x000000
            0x000000 0x000000 0x000000 0x000000 0x000000 0x000000 0x000000 0x000000
            0x000000 0x000000 0x000000 0x000000 0x000000 0x000000 0x000000 0x000000
            0x000000 0x000000 0x000000 0x000000 0x000000 0x000000 0x000000 0x000000
            0x000000 0x000000 0x000000 0x000000 0x000000 0x000000 0x000000 0x000000
            0x000000 0x000000 0x000000 0x000000 0x000000 0x000000 0x000000 0x000000
            0x000000 0x000000 0x000000 0x000000 0x000000 0x000000 0x000000 0x000000
            0x000000 0x000000 0x000000 0x000000 0x000000 0x000000 0x000000 0x000000
            0x000000 0x000000 0x000000 0x000000 0x000000 0x000000 0x000000 0x000000
            0x000000 0x000000 0x000000 0x000000 0x000000 0x000000 0x000000 0x000000
            0x000000 0x000000 0x000000 0x000000 0x000000 0x000000 0x000000 0x000000
            0x000000 0x000000 0x000000 0x000000 0x000000 0x000000 0x000000 0x000000
            0x000000 0x000000 0x000000 0x000000 0x000000 0x000000 0x000000 0x000000
            0x000000 0x000000 0x000000 0x000000 0x000000 0x000000 0x000000 0x000000
            0x000000 0x000000 0x000000 0x000000 0x000000 0x000000 0x000000 0x000000
            0x000000 0x000000 0x000000 0x000000 0x000000 0x000000 0x000000 0x000000
            0x000000 0x000000 0x000000 0x000000 0x000000 0x000000 0x000000 0x000000
            0x000000 0x000000 0x000000 0x000000 0x000000 0x000000 0x000000 0x000000
            0x000000 0x000000 0x000000 0x000000 0x000000 0x000000 0x000000 0x000000
            0x000000 0x000000 0x000000 0x000000 0x000000 0x000000 0x000000 0x000000
            0x000000 0x000000 0x000000 0x000000 0x000000 0x000000 0x000000 0x000000
            0x000000 0x000000 0x000000 0x000000 0x000000 0x000000 0x000000 0x000000
            0x000000 0x000000 0x000000 0x000000 0x000000 0x000000 0x000000 0x000000
            0x000000 0x000000 0x000000 0x000000 0x000000 0x000000 0x000000 0x000000
            0x000000 0x000000 0x000000 0x000000 0x000000 0x000000 0x000000 0x000000
            0x000000 0x000000 0x000000 0x000000 0x000000 0x000000 0x000000 0x000000
            0x000000 0x000000 0x000000 0x000000 0x000000 0x000000 0x000000 0x000000
            0x000000 0x000000 0x000000 0x000000 0x000000 0x000000 0x000000 0x000000
            0x000000 0x000000 0x000000 0x000000 0x000000 0x000000 0x000000 0x000000
            0x000000 0x000000 0x000000 0x000000 0x000000 0x000000 0x000000 0x000000
            0x000000 0x000000 0x000000 0x000000 0x000000 0x000000 0x000000 0x000000
            0x000000 0x000000 0x000000 0x000000 0x000000 0x000000 0x000000 0x000000
            0x000000 0x000000 0x000000 0x000000 0x000000 0x000000 0x000000 0x000000
            0x000000 0x000000 0x000000 0x000000 0x000000 0x000000 0x000000 0x000000
            0x000000 0x000000 0x000000 0x000000 0x000000 0x000000 0x000000 0x000000
            0x000000 0x000000 0x000000 0x000000 0x000000 0x000000 0x000000 0x000000
        >;
    };
};
